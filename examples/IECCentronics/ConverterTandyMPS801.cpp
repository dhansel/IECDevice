// -----------------------------------------------------------------------------
// Copyright (C) 2023 David Hansel
//
// This program is free software; you can redistribute it and/or modify
// it under the terms of the GNU General Public License as published by
// the Free Software Foundation; either version 3 of the License, or
// (at your option) any later version.
//
// This program is distributed in the hope that it will be useful,
// but WITHOUT ANY WARRANTY; without even the implied warranty of
// MERCHANTABILITY or FITNESS FOR A PARTICULAR PURPOSE.  See the
// GNU General Public License for more details.
//
// You should have received a copy of the GNU General Public License
// along with this program; if not, write to the Free Software Foundation,
// Inc., 51 Franklin Street, Fifth Floor, Boston, MA 02110-1301  USA
// -----------------------------------------------------------------------------

#include <Arduino.h>
#include "ConverterTandyMPS801.h"


#define MODE_MPS801_STANDARD    0
#define MODE_MPS801_GRAPHICS    1
#define MODE_MPS801_DWIDTH      2
#define MODE_MPS801_REVERSE     4
#define MODE_MPS801_CURSORDOWN  8
#define MODE_MPS801_TAB        16


static const byte font[162*6] PROGMEM = 
  {0x00,0x00,0x00,0x00,0x00,0x00, // 00: (space)
   0x00,0x00,0x5F,0x00,0x00,0x00, // 01: !
   0x00,0x07,0x00,0x07,0x00,0x00, // 02: "
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   0x12,0x49,0x24,0x12,0x49,0x24  // A1: (upward diagonal lines)
};


static const byte charset_standard[256] PROGMEM = 
  {
    0x00, 0x00, 0x00, 0x00, 0x00, 0x00, 0x00, 0x00, 0x00, 0x00, 0x00, 0x00, 0x00, 0x00, 0x00, 0x00, 
    0x00, 0x00, 0x00, 0x00, 0x00, 0x00, 0x00, 0x00, 0x00, 0x00, 0x00, 0x00, 0x00, 0x00, 0x00, 0x00, 
    0x00, 0x01, 0x02, 0x03, 0x04, 0x05, 0x06, 0x07, 0x08, 0x09, 0x0a, 0x0b, 0x0c, 0x0d, 0x0e, 0x0f, 
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    0x90, 0x91, 0x92, 0x93, 0x94, 0x95, 0x96, 0x97, 0x98, 0x99, 0x9a, 0x9b, 0x9c, 0x9d, 0x9e, 0x7e  
  };


static const byte charset_business[256] PROGMEM = 
  {
    0x00, 0x00, 0x00, 0x00, 0x00, 0x00, 0x00, 0x00, 0x00, 0x00, 0x00, 0x00, 0x00, 0x00, 0x00, 0x00, 
    0x00, 0x00, 0x00, 0x00, 0x00, 0x00, 0x00, 0x00, 0x00, 0x00, 0x00, 0x00, 0x00, 0x00, 0x00, 0x00, 
    0x00, 0x01, 0x02, 0x03, 0x04, 0x05, 0x06, 0x07, 0x08, 0x09, 0x0a, 0x0b, 0x0c, 0x0d, 0x0e, 0x0f, 
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    0x90, 0x91, 0x92, 0x93, 0x94, 0x95, 0x96, 0x97, 0x98, 0x99, 0xa0, 0x9b, 0x9c, 0x9d, 0x9e, 0x5e
  };




ConverterTandyMPS801::ConverterTandyMPS801() : Converter()
{
  m_mode = MODE_MPS801_STANDARD;
  m_dotcolumn = 0;
}


void ConverterTandyMPS801::begin()
{
  m_mode = MODE_MPS801_STANDARD;
  m_cmdbytes = 0;
}


void ConverterTandyMPS801::setChannel(byte channel)
{
  if( channel==7 )
    m_mode |=  MODE_MPS801_CURSORDOWN;
  else
    m_mode &= ~MODE_MPS801_CURSORDOWN;
}


void ConverterTandyMPS801::convert()
{
  // only proceed if we have enough space to write 10 or more bytes
  if( canRead()>0 && canWrite()>=10 )
    {
      byte data = read();

      if( m_cmdbytes>0 )
        {
          if( m_mode & MODE_MPS801_TAB )
            {
              static byte tab1;
              if( m_cmdbytes==2 )
                {
                  tab1 = data;
                  m_cmdbytes = 1;
                }
              else
                {                
                  m_dotcolumn = ((tab1&0x0F)*10 + (data&0x0F)) * 6;
                  write(27);
                  write(16);
                  write(m_dotcolumn / 256);
                  write(m_dotcolumn & 255);
                  m_mode &= ~MODE_MPS801_TAB;
                  m_cmdbytes = 0;
                }
            }
          else
            {
              write(data);
              m_cmdbytes--;
            }
        }
      else if( (m_mode & MODE_MPS801_GRAPHICS) && data>=128 )
        {
          write(data);
          m_dotcolumn += (m_mode & MODE_MPS801_DWIDTH) ? 2 : 1;
          if( m_dotcolumn>=480 ) m_dotcolumn = 0;
        }
      else
        {
          switch( data )
            {
            case 8: // enter graphics mode
              write(18);
              m_mode = MODE_MPS801_GRAPHICS;
              break;

            case 10:
            case 13:
              if( m_mode & MODE_MPS801_GRAPHICS )
                write(data);
              else
                { write(30); write(data); write(18); }
              if( data==13 ) m_mode &= ~(MODE_MPS801_CURSORDOWN|MODE_MPS801_REVERSE);
              m_dotcolumn = 0;
              break;

            case 14: // double width
              write(27);
              write(14);
              m_mode |= MODE_MPS801_DWIDTH;
              break;

            case 15: // standard mode (clear all others)
              if( m_mode & MODE_MPS801_DWIDTH ) { write(27); write(15); }
              m_mode = MODE_MPS801_STANDARD;
              break;

            case 16: // TAB setting the print head (followed by two characters specifying column
              m_mode |= MODE_MPS801_TAB;
              m_cmdbytes = 2;
              break;

            case 17: // "cursor down" (business) mode
              m_mode |= MODE_MPS801_CURSORDOWN;
              break;

            case 18: // reverse mode
              m_mode |= MODE_MPS801_REVERSE;
              break;

            case 26: // repeat graphics (followed by length and data byte)
              write(28);
              m_cmdbytes = 2;
              break;

            case 27: // specify dot address (followed by 16 and two-byte dot column)
              write(27);
              m_cmdbytes = 3;
              break;

            case 145: // "cursor up" (standard) mode
              m_mode &= ~MODE_MPS801_CURSORDOWN;
              break;

            case 146: // turn off reverse mode
              m_mode &= ~MODE_MPS801_REVERSE;
              break;

            default:
              {
                byte charIdx  = (m_mode & MODE_MPS801_CURSORDOWN) ? pgm_read_byte(charset_business+data) : pgm_read_byte(charset_standard+data);
                const byte *charData = font + charIdx*6;
                
                write(18);
                for(byte i=0; i<6; i++) 
                  {
                    if( m_dotcolumn>=480 )
                      {
                        if( (m_mode & MODE_MPS801_GRAPHICS)==0) 
                          { write(30); write(13); write(18); }
                        m_dotcolumn = 0;
                      }
                    
                    data = pgm_read_byte(charData+i);
                    if( m_mode & MODE_MPS801_REVERSE ) data = ~data;
                    write(data | 0x80);
                  }
               
                m_dotcolumn += (m_mode & MODE_MPS801_DWIDTH) ? 12 : 6;
                break;
              }
            }          
        }
    }
}
